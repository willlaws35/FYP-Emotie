//  ___       ___
// /   \     /   \
//|     |---|     |
// \___/     \___/
//
 //  L     R


//9 = blue = REYE
//10 = green = LEYE
//47 = green = LBROW1
//46 = blue = RBROW2
//45 = green = LBROW2
//44 = blue = RBROW1

//upload file Obi-Wan Says Hello There (128 kbps) (mp3cut.net) 

#include <SD.h>
#include <SPI.h>
#include <Wire.h>
#include <Servo.h>
#include <Stepper.h>
#include <ezButton.h>
#include <Adafruit_GFX.h>
#include <SoftwareSerial.h>
#include <DFRobot_DF1201S.h>
#include <Adafruit_SSD1306.h>
#include <Adafruit_NeoPixel.h>

#define PIN 6
#define NUMPIXELS 24
#define NUMPIXELSMIN 24

#define SCREEN_WIDTH 128
#define SCREEN_HEIGHT 64

#define OLED_RESET     -1
#define SCREEN_ADDRESS 0x3C

Adafruit_SSD1306 display(SCREEN_WIDTH, SCREEN_HEIGHT, &Wire, OLED_RESET);

#define LOGO_HEIGHT   64
#define LOGO_WIDTH    128

Sd2Card card;
SdVolume volume;
SdFile root;

int echoPinR = 35;
int trigPinR = 34;
int echoPin = 37;
int trigPin = 36;
int echoPinL = 39;    
int trigPinL = 38;

int val;
int pos = 0;
int potpin = 7;
int delayval = 50;
int calibrated = 0;
const int chipSelect = 53;
const int stepsPerRevolution = 200;
long MOT1, MOT2, MOT3, MOT4, MOT5, MOT6;
unsigned long Time, TempRec;

// 'boswin hex test', 128x64px
const unsigned char boswin_test [] PROGMEM = {
  0xff, 0xff, 0xff, 0xff, 0xff, 0xff, 0xff, 0xff, 0xff, 0xff, 0xff, 0xff, 0xff, 0xff, 0xff, 0xff, 
  0xff, 0xff, 0xff, 0xff, 0xff, 0xff, 0xff, 0xff, 0xff, 0xff, 0xff, 0xff, 0xff, 0xff, 0xff, 0xff, 
  0xff, 0xff, 0xff, 0xff, 0xff, 0xff, 0xff, 0xff, 0xff, 0xff, 0xff, 0xff, 0xff, 0xff, 0xff, 0xff, 
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  0xff, 0xff, 0xff, 0xff, 0xff, 0xff, 0xff, 0xff, 0xff, 0xff, 0xff, 0xff, 0xff, 0xff, 0xff, 0xff
};

// 'Emotie test screen', 128x64px
const unsigned char Emotie_test_screen [] PROGMEM = {
  0xff, 0xff, 0xff, 0xff, 0xff, 0xff, 0xff, 0xff, 0xff, 0xff, 0xff, 0xff, 0xff, 0xff, 0xff, 0xff, 
  0xff, 0xff, 0xff, 0xff, 0xff, 0xff, 0xff, 0xff, 0xff, 0xff, 0xff, 0xff, 0xff, 0xff, 0xff, 0xff, 
  0xff, 0xff, 0xff, 0xff, 0xff, 0xff, 0xff, 0xff, 0xff, 0xff, 0xff, 0xff, 0xff, 0xff, 0xff, 0xff, 
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  0xff, 0xff, 0xff, 0xff, 0xff, 0xff, 0xff, 0xff, 0xff, 0xff, 0xff, 0xff, 0xff, 0xff, 0xff, 0xff
};



float lowest =0, duration_usR, distance_cmR, duration_us, 
      distance_cm,duration_usL, distance_cmL;



//reye = 10, leye = 9
ezButton toggleSwitch(18), input(17) ;
Servo REYE, LEYE, RBROW1, RBROW2, LBROW1, LBROW2, calibrate;
Stepper myStepper = Stepper(stepsPerRevolution, 2,3,4,5);
Adafruit_NeoPixel pixels = Adafruit_NeoPixel(NUMPIXELS, PIN, NEO_GRB + NEO_KHZ800);
Adafruit_NeoPixel pixelsMIN = Adafruit_NeoPixel(NUMPIXELSMIN, PIN, NEO_GRB + NEO_KHZ800);
SoftwareSerial DF1201SSerial(12, 13);  //RX  TX
SoftwareSerial BLE(14,15); // TX RX
DFRobot_DF1201S DF1201S;
File myFile;

void setup() {

  Serial.begin(115200);
  DF1201SSerial.begin(115200);
  BLE.begin(9600);
  pixels.begin();
  pixelsMIN.begin();

  for (int i=0; i<=12; i++){
    pixels.setPixelColor(12-i, pixels.Color(0,0,50));
    pixels.setPixelColor(12+i, pixels.Color(0,0,50));
    delay(125);
    pixels.show();
  }
   if(!display.begin(SSD1306_SWITCHCAPVCC, SCREEN_ADDRESS)) {
    Serial.println(F("SSD1306 allocation failed"));
    for(;;); // Don't proceed, loop forever
  }
  display.display();
  delay(2000); 
  display.clearDisplay();
  delay(1000);
  display.invertDisplay(true);
  delay(1000);
  display.drawBitmap(
    (display.width()  - LOGO_WIDTH ) / 2,
    (display.height() - LOGO_HEIGHT) / 2,
   boswin_test, LOGO_WIDTH, LOGO_HEIGHT, 1);
  display.display();
  delay(2000);
  display.clearDisplay();
  delay(2000);
  display.drawBitmap(
      (display.width() - LOGO_WIDTH) /2,
      (display.height() - LOGO_HEIGHT) / 2,
      Emotie_test_screen, LOGO_WIDTH, LOGO_HEIGHT, 1);
  display.display();
  delay(2000);
  
 
  pixels.setPixelColor(0, pixels.Color(0,0,0)); 
  delay(125);
  pixels.show();
  for (int i=12;i>=0;i--){
    pixels.setPixelColor(12-i, pixels.Color(0,0,0));
    pixels.setPixelColor(i+12, pixels.Color(0,0,0));
    delay(125);
    pixels.show();
  }
  while (!Serial) {
  }


  Serial.print("\nInitializing SD card...");
  BLE.print("Initializing");
  delay(50);
  BLE.print("SD card...");
  
  if (!card.init(SPI_HALF_SPEED, chipSelect)) {
    Serial.println("initialization failed. Things to check:");
    BLE.println("initialization failed. Things to check:");
    Serial.println("* is a card inserted?");
    BLE.println("* is a card inserted?");
    Serial.println("* is your wiring correct?");
    BLE.println("* is your wiring correct?");
    Serial.println("* did you change the chipSelect pin to match your shield or module?");
    BLE.println("* did you change the chipSelect pin to match your shield or module?");
    while (1);
  } else {
    Serial.println("Wiring is correct and a card is present.");
    BLE.println("Wiring is correct");delay(50);
    BLE.println("and a card");delay(50);
    BLE.println("is present.");delay(50);
    
  }

  // print the type of card
  Serial.println();
  BLE.println();
  Serial.print("Card type:         ");
  BLE.print("Card type:         ");
  switch (card.type()) {
    case SD_CARD_TYPE_SD1:
      Serial.println("SD1");
      BLE.println("SD1");
      break;
    case SD_CARD_TYPE_SD2:
      Serial.println("SD2");
      BLE.print("SD2");
      break;
    case SD_CARD_TYPE_SDHC:
      Serial.println("SDHC");
      BLE.println("SDHC");
      break;
    default:
      Serial.println("Unknown");
      BLE.println("Unknown");
  }

  // Now we will try to open the 'volume'/'partition' - it should be FAT16 or FAT32
  if (!volume.init(card)) {
    Serial.println("Could not find FAT16/FAT32 partition.\nMake sure you've formatted the card");
    BLE.println("Could not find FAT16/FAT32 partition.\nMake sure you've formatted the card");
    while (1);
  }

  Serial.print("Clusters:          ");
  BLE.print("Clusters:          ");
  Serial.println(volume.clusterCount());
  BLE.println(volume.clusterCount());
  Serial.print("Blocks x Cluster:  ");
  BLE.print("Blocks x Cluster:  ");
  Serial.println(volume.blocksPerCluster());
  BLE.println(volume.blocksPerCluster());

  Serial.print("Total Blocks:      ");
  BLE.print("Total Blocks:      ");
  Serial.println(volume.blocksPerCluster() * volume.clusterCount());
  BLE.println(volume.blocksPerCluster() * volume.clusterCount());
  Serial.println();
  BLE.println();

  // print the type and size of the first FAT-type volume
  uint32_t volumesize;
  Serial.print("Volume type is:    FAT");
  BLE.print("Volume type is:    FAT");
  Serial.println(volume.fatType(), DEC);
  BLE.println(volume.fatType(), DEC);

  volumesize = volume.blocksPerCluster();    // clusters are collections of blocks
  volumesize *= volume.clusterCount();       // we'll have a lot of clusters
  volumesize /= 2;                           // SD card blocks are always 512 bytes (2 blocks are 1KB)
  Serial.print("Volume size (Kb):  ");
  BLE.print("Volume size (Kb):  ");
  Serial.println(volumesize);
  BLE.println(volumesize);
  Serial.print("Volume size (Mb):  ");
  BLE.print("Volume size (Mb):  ");
  volumesize /= 1024;
  Serial.println(volumesize);
  BLE.println(volumesize);
  Serial.print("Volume size (Gb):  ");
  BLE.print("Volume size (Gb):  ");
  Serial.println((float)volumesize / 1024.0);
  BLE.println((float)volumesize / 1024.0);


//file reading dump
Serial.print("Initializing SD card...");

  if (!SD.begin(53)) {
    Serial.println("initialization failed!");
    while (1);
  }
  Serial.println("initialization done.");

  // open the file. note that only one file can be open at a time,
  // so you have to close this one before opening another.
  delay(5000);
  toggleSwitch.setDebounceTime(50);

  REYE.attach(10);
  LEYE.attach(9);
  RBROW1.attach(44);
  LBROW1.attach(47);
  RBROW2.attach(46);
  LBROW2.attach(45);
  calibrate.attach(8);
  myStepper.setSpeed(10);

    while(!DF1201S.begin(DF1201SSerial)){
    Serial.println("Init failed, please check the wire connection!");
    BLE.println("Init failed, please check the wire connection!");
    delay(1000);
  }
  /*Set volume to 20*/
  DF1201S.setVol(/*VOL = */20);
  //DF1201S.enableAMP();
  //Serial.println("AMP ENABLED");
  //BLE.println("AMP ENABLED");
  Serial.print("VOL:");
  BLE.println("VOL:");
  /*Get volume*/
  Serial.println(DF1201S.getVol());
  BLE.println(DF1201S.getVol());
  DF1201S.switchFunction(DF1201S.MUSIC);
  delay(1000);
  DF1201S.setPlayMode(DF1201S.SINGLE);

  
  pinMode(trigPinR, OUTPUT);
  pinMode(trigPin, OUTPUT);
  pinMode(trigPinL, OUTPUT);
  pinMode(echoPinR, INPUT);
  pinMode(echoPin, INPUT);
  pinMode(echoPinL, INPUT);
 Serial.begin(9600);

  //servo format
  REYE.write(180);
  LEYE.write(0);
  delay(500);
  RBROW1.write(180);
  LBROW1.write(0);
  delay(500);
  RBROW2.write(0);
  LBROW2.write(180);
  delay(500);
  
 
 // red pixel loop
  pixels.begin();
  pixels.setPixelColor(12, pixels.Color(50,0,0)); 
  delay(125);
  pixels.show();
  for (int i=0;i<=12;i++){
    pixels.setPixelColor(12-i, pixels.Color(50,0,0));
    pixels.setPixelColor(12+i, pixels.Color(50,0,0));
    delay(125);
    pixels.show();
  }
  delay(250);  
  pixels.setPixelColor(0, pixels.Color(0,0,0)); 
  delay(125);
  pixels.show();
  for (int i=12;i>=0;i--){
    pixels.setPixelColor(12-i, pixels.Color(0,0,0));
    pixels.setPixelColor(i+12, pixels.Color(0,0,0));
    delay(125);
    pixels.show();
  }
  delay(250); 
  
  //green pixel loop
  Serial.begin(9600);
  pixels.begin();
  pixels.setPixelColor(12, pixels.Color(0,50,0)); 
  delay(125);
  pixels.show();
  for (int i=0;i<=12;i++){
    pixels.setPixelColor(12-i, pixels.Color(0,50,0));
    pixels.setPixelColor(12+i, pixels.Color(0,50,0));
    delay(125);
    pixels.show();
  }
  delay(250);  
  pixels.setPixelColor(0, pixels.Color(0,0,0)); 
  delay(125);
  pixels.show();
  for (int i=12;i>=0;i--){
    pixels.setPixelColor(12-i, pixels.Color(0,0,0));
    pixels.setPixelColor(i+12, pixels.Color(0,0,0));
    delay(125);
    pixels.show();
  }
  delay(250);
  
  //blue pixel loop
  Serial.begin(9600);
  pixels.begin();
  pixels.setPixelColor(12, pixels.Color(0,0,50)); 
  delay(125);
  pixels.show();
  for (int i=0;i<=12;i++){
    pixels.setPixelColor(12-i, pixels.Color(0,0,50));
    pixels.setPixelColor(12+i, pixels.Color(0,0,50));
    delay(125);
    pixels.show();
  }
  delay(250);  
  pixels.setPixelColor(0, pixels.Color(0,0,0)); 
  delay(125);
  pixels.show();
  for (int i=12;i>=0;i--){
    pixels.setPixelColor(12-i, pixels.Color(0,0,0));
    pixels.setPixelColor(i+12, pixels.Color(0,0,0));
    delay(125);
    pixels.show();
  }
  delay(250);

  //white pixel loop
  Serial.begin(9600);
  pixels.begin();
  pixels.setPixelColor(12, pixels.Color(32,32,32)); 
  delay(125);
  pixels.show();
  for (int i=0;i<=12;i++){
    pixels.setPixelColor(12-i, pixels.Color(32,32,32));
    pixels.setPixelColor(12+i, pixels.Color(32,32,32));
    delay(125);
    pixels.show();
  }
  delay(250);  
  
  //run calibration
  while (calibrated == 0){
     for(int i=0;i<NUMPIXELSMIN;i++)
  {
    pixelsMIN.setPixelColor(i, pixelsMIN.Color(8,8,8)); 
    delay(20);
    pixelsMIN.show(); 
  }
  delay(250);
  pixelsMIN.setPixelColor(13, pixelsMIN.Color(8,0,0));
  pixelsMIN.setPixelColor(12, pixelsMIN.Color(8,0,0));
  pixelsMIN.setPixelColor(11, pixelsMIN.Color(8,0,0));
  pixelsMIN.show();
  calibrate.write(0);
  delay(250);
     for(int i=0;i<NUMPIXELSMIN;i++)
  {
    pixelsMIN.setPixelColor(i, pixelsMIN.Color(8,8,8)); 
    delay(20);
    pixelsMIN.show(); 
  }
  delay(250);
 pixelsMIN.setPixelColor(13, pixelsMIN.Color(8,0,0));
  pixelsMIN.setPixelColor(12, pixelsMIN.Color(8,0,0));
  pixelsMIN.setPixelColor(11, pixelsMIN.Color(8,0,0));
  pixelsMIN.show();
  calibrate.write(0);
  delay(250);

  toggleSwitch.loop(); // MUST call the loop() function first

  if (toggleSwitch.isPressed())
    Serial.println("switch:OFF->ON");
    BLE.println("switch:OFF->ON");
    
  if (toggleSwitch.isReleased())
    Serial.println("switch:ON->OFF");
    BLE.println("switch:ON->OFF");

  int state = toggleSwitch.getState();
  if (state == HIGH){
    Serial.println("switch:OFF");
    BLE.println("switch:OFF");
         for(int i=0;i<NUMPIXELSMIN;i++)
  {
    pixelsMIN.setPixelColor(i, pixelsMIN.Color(8,0,0)); 
    delay(20);
    pixelsMIN.show(); 
  }
  }
  else if (state == LOW){
    Serial.println("switch:ON");
    BLE.println("switch:ON");
    calibrated = 1;
  }
    delay(500);
  calibrate.write(90);
  delay(1000);
  }
   Serial.write("successfully calibrated");
   BLE.write("successfully");
   delay(50);
   BLE.write("calibrated");
   delay(50);
   BLE.println("");
    for(int i=0;i<NUMPIXELSMIN;i++)
  {
    pixelsMIN.setPixelColor(i, pixelsMIN.Color(0,32,5)); 
    delay(125);
    pixelsMIN.show(); 
  }
  delay(500);
  DF1201S.last();
  DF1201S.last();
  Serial.write("Song Reset");
  BLE.write("Song Reset");
  }
  

void loop() {
   //servo format
  REYE.write(180);
  LEYE.write(0);
  delay(500);
  RBROW1.write(180);
  LBROW1.write(0);
  delay(500);
  RBROW2.write(0);
  LBROW2.write(180);
  delay(500);
  
  digitalWrite(trigPinR, HIGH);
  delayMicroseconds(10);
  digitalWrite(trigPinR, LOW);
  duration_usR = pulseIn(echoPinR, HIGH);
  distance_cmR = 0.017 * duration_usR;
  
  digitalWrite(trigPin, HIGH);
  delayMicroseconds(10);
  digitalWrite(trigPin, LOW);
  duration_us = pulseIn(echoPin, HIGH);
  distance_cm = 0.017 * duration_us;
   
  digitalWrite(trigPinL, HIGH);
  delayMicroseconds(10);
  digitalWrite(trigPinL, LOW);
  duration_usL = pulseIn(echoPinL, HIGH);
  distance_cmL = 0.017 * duration_usL;

  Serial.print("RIGHT: ");
  Serial.print(distance_cmR);
  Serial.print(" cm ");
  BLE.print("RIGHT: ");
  delay(50);
  BLE.print(distance_cmR);
  delay(50);
  BLE.println("cm");
  delay(50);
  
  Serial.print("MID: ");
  Serial.print(distance_cm);
  Serial.print(" cm ");
  BLE.print("MID: ");
  delay(50);
  BLE.print(distance_cm);
  delay(50);
  BLE.println(" cm ");
  delay(50);
  
  Serial.print("LEFT: ");
  Serial.print(distance_cmL);
  Serial.print(" cm ");
  BLE.print("LEFT: ");
  delay(50);
  BLE.print(distance_cmL);
  delay(50);
  BLE.println(" cm ");
  delay(50);
  
  if(distance_cm<distance_cmR){
    if (distance_cm<distance_cmL){
      Serial.print("MID LOW");BLE.print("MID LOW");
      lowest = 2;
    }
  }
  if(distance_cmR<distance_cm){
    if(distance_cmR<distance_cmL){
      Serial.print("RIGHT LOW");BLE.print("RIGHT LOW");
      lowest = 1;
    }
  }
  if(distance_cmL<distance_cm){
    if(distance_cmL<distance_cmR){
      Serial.print("LEFT LOW");BLE.print("LEFT LOW");
      lowest = 3;
    }
  }
  
  Serial.println(lowest);
  
  if (lowest==1){
    if (distance_cmR < 150){
       lowest = 5;
       for(int i=0;i<NUMPIXELS;i++){
         pixels.setPixelColor(i, pixels.Color(0,32,0)); 
         delay(20);
         pixels.show(); 
       }
    }   
  }

  if (lowest==2){
    if (distance_cm<150){
     lowest = 5;
     for(int i=0;i<NUMPIXELS;i++){
       pixels.setPixelColor(i, pixels.Color(0,0,32)); 
       delay(20);
       pixels.show(); 
     }
    }
   }
   
  if (lowest==3){
    if (distance_cmL < 150){
      lowest = 5;
     for(int i=0;i<NUMPIXELS;i++){
       pixels.setPixelColor(i, pixels.Color(32,0,0)); 
       delay(20);
       pixels.show(); 
     }
    } 
  }
  
  for(int i=0;i<NUMPIXELS;i++){
    pixels.setPixelColor(i, pixels.Color(32,32,32)); 
    delay(20);
    pixels.show(); 
  }
  
  if (lowest == 5){
     Serial.println("Start playing");BLE.println("Start playing");
     DF1201S.playFileNum(1);delay(5200);
     Serial.println("Previous");BLE.println("Previous");DF1201S.last();
     Serial.println("Pause");BLE.write("Pause");DF1201S.pause();
     
    Serial.write("Client Detected");BLE.write("Client Detected");
    TempRec = millis();Time = millis();
    
    while (Time <= (TempRec+10000)){
    Time = millis();
    input.loop();int InputState = input.getState();
    if (InputState == 0){
      Serial.write("Interaction Made");BLE.write("Interaction Made");
      
      Serial.println("Start playing");BLE.println("Start playing");
      DF1201S.playFileNum(2);delay(22000);
      Serial.println("Previous");BLE.println("Previous");DF1201S.last();
      Serial.println("Pause");BLE.write("Pause");DF1201S.pause();
      
      Serial.println("ready for go query");BLE.println("ready for go query");
      TempRec = millis();Time = millis();
      
      while (Time <= (TempRec+10000)){
      Time = millis();
      input.loop();int InputState = input.getState();
      if (InputState == 0){
          Serial.println("query accepted");BLE.println("query accepted");
          Serial.println("Generating Emotion");BLE.println("Generating Emotion");
          
          MOT1 = random(0,18);MOT2 = random(0,18);MOT3 = random(0,18);MOT4 = random(0,18);MOT5 = random(0,18);MOT6 = random(0,18);
          REYE.write(MOT1*10);LEYE.write(MOT2*10);delay(500);
          RBROW1.write(MOT3*10);LBROW1.write(MOT4*10);delay(500);
          RBROW2.write(MOT5*10);LBROW2.write(MOT6*10);delay(2500);
          
          Serial.println("Serial Code: ");Serial.print(MOT1);Serial.print(MOT2);Serial.print(MOT3);Serial.print(MOT4);Serial.print(MOT5);Serial.print(MOT6);
          BLE.println("Serial Code: ");BLE.print(MOT1);Serial.print(MOT2);Serial.print(MOT3);Serial.print(MOT4);Serial.print(MOT5);Serial.print(MOT6);
          
          TempRec = millis();Time = millis();
          
          while (Time <= (TempRec+10000)){
          Time = millis();
          input.loop();int InputState = input.getState();
          if (InputState == 0){
            Serial.println("Getting Score");BLE.println("Getting Score");
            
            val = analogRead(potpin);            // reads the value of the potentiometer (value between 0 and 1023)
            val = map(val, 0, 1023, 0, 180);
            int Valid_Write = 0;
            while (Valid_Write == 0){
               if (!SD.begin(53)) {Serial.println("initialization failed!");BLE.println("initialization failed!");}    
               Serial.println("initialization done.");BLE.println("initialization done.");
               myFile = SD.open("distance.txt",FILE_WRITE);
              
              // if the file opened okay, write to it:
              if (myFile) {
              Serial.print("Writing to distance.txt...");BLE.print("Writing to distance.txt...");
              myFile.print("Distance Left: ");myFile.print(distance_cmL);
              myFile.print(" Distance Mid: ");myFile.print(distance_cm);
              myFile.print(" Distance Right: ");myFile.print(distance_cmR);
              myFile.print(" MOT1: ");myFile.print(MOT1);
              myFile.print(" MOT2: ");myFile.print(MOT2);
              myFile.print(" MOT3: ");myFile.print(MOT3);
              myFile.print(" MOT4: ");myFile.print(MOT4);
              myFile.print(" MOT5: ");myFile.print(MOT5);
              myFile.print(" MOT6: ");myFile.print(MOT6);
              myFile.print(" SCORING: ");myFile.print(val);                 
              myFile.println();
              
              // close the file:
              myFile.close();
              Serial.println("done."); BLE.println("done.");
              Valid_Write = 1;
            } 
            else {Serial.println("error opening distance.txt");BLE.println("error opening distance.txt");}
            }
            
            Serial.println("Start playing");BLE.println("Start playing");
            DF1201S.playFileNum(3);delay(4200);
            Serial.println("Previous");BLE.write("Pause");DF1201S.last();
            Serial.println("Pause");BLE.write("Pause");DF1201S.pause();
            Time = TempRec+11000;
          }    
        }
       }
      }
     }
    }
   }
  lowest = 0;  
  //servo format
  REYE.write(180);LEYE.write(0);delay(200);
  RBROW1.write(180);LBROW1.write(0);delay(200);
  RBROW2.write(0);LBROW2.write(180);delay(200);
  }
